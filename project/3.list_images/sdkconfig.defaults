## project/3.list_images/sdkconfig.defaults
```kconfig
CONFIG_IDF_TARGET="esp32s3"

CONFIG_FATFS_VFS_FSTAT_BLKSIZE=4096
CONFIG_EXAMPLE_PIN_MOSI=9
CONFIG_EXAMPLE_PIN_MISO=8
CONFIG_EXAMPLE_PIN_CLK=7
CONFIG_EXAMPLE_PIN_CS=21
```

## project/classification/classifier/main/Kconfig.projbuild
```kconfig
menu "Classifier Configuration"

config CLASSIFIER_MODEL_PATH
    string "ESP-DL model path"
    default "/sdcard/model.espdl"
    help
        Path to the ESP-DL model file.

config CLASSIFIER_IMAGE_FOLDER
    string "Image folder"
    default "/sdcard/images"
    help
        Directory containing JPEG images to classify.

config CLASSIFIER_INPUT_SCALE
    float "Input quantization scale"
    default 0.0078125
    help
        Input tensor scale used by the quantized model.

config CLASSIFIER_INPUT_ZERO_POINT
    int "Input quantization zero point"
    default 0
    help
        Input tensor zero point used by the quantized model.

config CLASSIFIER_USE_EMBEDDED_MODEL
    bool "Use embedded model"
    default y
    help
        Load model from flash instead of SD card.

config CLASSIFIER_MAX_IMAGE_FILES
    int "Maximum image files"
    range 1 10000
    default 1000
    help
        Maximum number of JPEG files processed in a single run.

config CLASSIFIER_ENABLE_RECURSIVE_SCAN
    bool "Enable recursive directory scan"
    default n
    help
        Search for images in subdirectories.

config CLASSIFIER_LOG_TOP5
    bool "Print Top-5 predictions"
    default n
    help
        Print the five highest scoring classes.

config CLASSIFIER_RUNTIME_MODE_MULTICORE
    bool "Use ESP-DL multi-core runtime"
    default y
    help
        Enables dl::RUNTIME_MODE_MULTI_CORE.

config CLASSIFIER_INPUT_WIDTH
    int "Input width"
    range 32 1024
    default 224

config CLASSIFIER_INPUT_HEIGHT
    int "Input height"
    range 32 1024
    default 224

config CLASSIFIER_INPUT_CHANNELS
    int "Input channels"
    range 1 4
    default 3

endmenu
```

## project/myclassifier/sdkconfig.defaults
```kconfig
CONFIG_IDF_CMAKE=y
CONFIG_IDF_TOOLCHAIN="gcc"
CONFIG_IDF_TOOLCHAIN_GCC=y
CONFIG_IDF_TARGET_ARCH_XTENSA=y
CONFIG_IDF_TARGET_ARCH="xtensa"
CONFIG_IDF_TARGET="esp32s3"
CONFIG_IDF_INIT_VERSION="6.2.0"
CONFIG_IDF_TARGET_ESP32S3=y
CONFIG_IDF_FIRMWARE_CHIP_ID=0x0009

CONFIG_PARTITION_TABLE_CUSTOM=y
CONFIG_PARTITION_TABLE_CUSTOM_FILENAME="partitions.csv"

CONFIG_ESPTOOLPY_FLASHSIZE="4MB"
CONFIG_ESPTOOLPY_FLASHSIZE_4MB=y

CONFIG_SPIRAM=y
CONFIG_SPIRAM_MODE_QUAD=y
# CONFIG_SPIRAM_MODE_OCT is not set
CONFIG_SPIRAM_TYPE_AUTO=y
# CONFIG_SPIRAM_TYPE_ESPPSRAM16 is not set
# CONFIG_SPIRAM_TYPE_ESPPSRAM32 is not set
# CONFIG_SPIRAM_TYPE_ESPPSRAM64 is not set
CONFIG_SPIRAM_CLK_IO=30
CONFIG_SPIRAM_CS_IO=26
# CONFIG_SPIRAM_XIP_FROM_PSRAM is not set
# CONFIG_SPIRAM_FETCH_INSTRUCTIONS is not set
# CONFIG_SPIRAM_RODATA is not set
# CONFIG_SPIRAM_SPEED_120M is not set
# CONFIG_SPIRAM_SPEED_80M is not set
CONFIG_SPIRAM_SPEED_40M=y
CONFIG_SPIRAM_SPEED=40
CONFIG_SPIRAM_BOOT_HW_INIT=y
CONFIG_SPIRAM_BOOT_INIT=y
CONFIG_SPIRAM_PRE_CONFIGURE_MEMORY_PROTECTION=y
# CONFIG_SPIRAM_IGNORE_NOTFOUND is not set
# CONFIG_SPIRAM_USE_MEMMAP is not set
# CONFIG_SPIRAM_USE_CAPS_ALLOC is not set
CONFIG_SPIRAM_USE_MALLOC=y
CONFIG_SPIRAM_MEMTEST=y
CONFIG_SPIRAM_MALLOC_ALWAYSINTERNAL=16384
# CONFIG_SPIRAM_TRY_ALLOCATE_WIFI_LWIP is not set
CONFIG_SPIRAM_MALLOC_RESERVE_INTERNAL=32768
# CONFIG_SPIRAM_ALLOW_BSS_SEG_EXTERNAL_MEMORY is not set
# CONFIG_SPIRAM_ALLOW_NOINIT_SEG_EXTERNAL_MEMORY is not set
CONFIG_ESP32S3_SPIRAM_SUPPORT=y
CONFIG_SPIRAM_ALLOW_STACK_EXTERNAL_MEMORY=y
```
